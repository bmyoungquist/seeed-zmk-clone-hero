## config/boards/shields/clone_hero_controller/Kconfig.shield
```kconfig
# Copyright (c) 2022 The ZMK Contributors
# SPDX-License-Identifier: MIT

config SHIELD_CLONE_HERO_CONTROLLER
    def_bool $(shields_list_contains,clone_hero_controller)
```

/ {
	chosen {
		zmk,kscan = &kscan0;
	};

	kscan0: kscan0 {
		compatible = "zmk,kscan-gpio-direct";
		wakeup-source;
		debounce-press-ms = <80>;
		debounce-release-ms = <3>;
		input-gpios
			= <&xiao_d 0 (GPIO_ACTIVE_HIGH)>
			, <&xiao_d 1 (GPIO_ACTIVE_HIGH)>
			, <&xiao_d 2 (GPIO_ACTIVE_HIGH)>
			, <&xiao_d 3 (GPIO_ACTIVE_HIGH)>
			, <&xiao_d 4 (GPIO_ACTIVE_HIGH)>
			, <&xiao_d 5 (GPIO_ACTIVE_HIGH)>
			, <&xiao_d 6 (GPIO_ACTIVE_HIGH)>
			, <&xiao_d 7 (GPIO_ACTIVE_HIGH)>
			, <&xiao_d 8 (GPIO_ACTIVE_HIGH)>
			;
	};
};
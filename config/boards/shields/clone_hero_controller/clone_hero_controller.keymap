#include <behaviors.dtsi>
#include <dt-bindings/zmk/keys.h>
#include <dt-bindings/zmk/bt.h>

#define BASE 0
#define BTL 1

/ {
	keymap {
		compatible = "zmk,keymap";

		base_layer {
			label = "BASE";
			bindings = <
				&kp NUMBER_1 &kp NUMBER_2 &kp NUMBER_3 &kp NUMBER_4 &kp NUMBER_5 &kp UP_ARROW &kp DOWN_ARROW &kp ESC &lt BTL DEL
			>;
		};

		bluetooth_layer {
			label = "BTL";
			bindings = <
				&bt BT_SEL 0 &bt BT_SEL 1 &bt BT_SEL 2 &bt BT_SEL 3 &bt BT_CLR &trans &trans &trans &trans
			>;
		};
	};
};
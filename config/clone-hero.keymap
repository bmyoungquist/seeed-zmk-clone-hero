#include <behaviors.dtsi>
#include <dt-bindings/zmk/keys.h>

/ {
	keymap {
		compatible = "zmk,keymap";

		default_layer {
			display-name = "guitar";

			bindings = <
				&kp NUMBER_1 &kp NUMBER_2 &kp NUMBER_3 &kp NUMBER_5 &kp NUMBER_5 &kp UP_ARROW &kp DOWN_ARROW &kp ESC &kp DEL
			>;
		}
	};
}